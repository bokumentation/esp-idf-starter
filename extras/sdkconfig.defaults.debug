## extras/sdkconfig.defaults.debug
```kconfig
# Debug Build Profile
# Override base defaults for debug builds
#
# Usage: idf.py -DSDKCONFIG_DEFAULTS=sdkconfig.defaults.debug build

# Logging - Verbose
CONFIG_LOG_DEFAULT_LEVEL_VERBOSE=y
CONFIG_LOG_DEFAULT_LEVEL=5
CONFIG_LOG_COLORS=y

# Assertions
CONFIG_COMPILER_OPTIMIZATION_ASSERTIONS_ENABLE=y
CONFIG_OPTIMIZATION_ASSERTIONS_ENABLED=y

# Compiler - No optimization for easier debugging
CONFIG_COMPILER_OPTIMIZATION_DEBUG=y

# Stack checking
CONFIG_FREERTOS_CHECK_STACKOVERFLOW=y
CONFIG_FREERTOS_WATCHPOINT_END_OF_STACK=y
```

## extras/sdkconfig.defaults.release
```kconfig
# Release Build Profile
# Override base defaults for release builds
#
# Usage: idf.py -DSDKCONFIG_DEFAULTS=sdkconfig.defaults.release build

# Logging - Minimal (only errors)
CONFIG_LOG_DEFAULT_LEVEL_ERROR=y
CONFIG_LOG_DEFAULT_LEVEL=1
CONFIG_LOG_COLORS=n

# Assertions - Disabled for size/speed
CONFIG_COMPILER_OPTIMIZATION_ASSERTIONS_DISABLE=y

# Compiler - Optimize for size
CONFIG_COMPILER_OPTIMIZATION_SIZE=y

# Stack checking - Minimal
# CONFIG_FREERTOS_CHECK_STACKOVERFLOW is not set
```
